## configs/t610yp_defconfig
```kconfig
CONFIG_XNU_MACHINE_CONFIG="BCM2837"
CONFIG_XNU_ARM_DT_PLATFORM=y
CONFIG_XNU_ARMCPU=y
CONFIG_XNU_SOURCE_CORECRYPTO14=y
CONFIG_XNU_SOURCE_PTHREAD=y
CONFIG_XNU_CRYPTO_BOOTSTRAP="source"
CONFIG_XNU_NATIVE_ARCH_TIMER=y
CONFIG_XNU_NATIVE_PAN=y
CONFIG_XNU_NATIVE_TRUST_CACHE=0
CONFIG_XNU_NATIVE_UFS=n
CONFIG_XNU_NATIVE_MOBILE_DISPLAY=n
CONFIG_XNU_NATIVE_ADRENO=n
CONFIG_XNU_BUILD_ARCHIVES=n
```
